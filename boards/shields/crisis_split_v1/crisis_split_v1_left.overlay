#include "crisis_split_v1.dtsi"

&kscan0 {
    // nice nano
    col-gpios
        = <&gpio1 11 GPIO_ACTIVE_HIGH> // left
        , <&gpio0 10 GPIO_ACTIVE_HIGH>
        , <&gpio0  9 GPIO_ACTIVE_HIGH>
        , <&gpio0 11 GPIO_ACTIVE_HIGH>
        , <&gpio1  4 GPIO_ACTIVE_HIGH>
        , <&gpio0 31 GPIO_ACTIVE_HIGH>
        , <&gpio0 20 GPIO_ACTIVE_HIGH>
        , <&gpio0 17 GPIO_ACTIVE_HIGH> // right
        ;
};


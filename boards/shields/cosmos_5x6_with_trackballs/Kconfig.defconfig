## boards/shields/cosmos_5x6_with_trackballs/Kconfig.defconfig
```kconfig
if SHIELD_COSMOS_5X6_WITH_TRACKBALLS_LEFT

    config ZMK_KEYBOARD_NAME
        default "COSMOSTRCK"

    config ZMK_SPLIT_BLE_ROLE_CENTRAL
        default y

endif

if SHIELD_COSMOS_5X6_WITH_TRACKBALLS_RIGHT

    config ZMK_KEYBOARD_NAME
        default "COSMOSTRCK_R"

endif

if SHIELD_COSMOS_5X6_WITH_TRACKBALLS_LEFT || SHIELD_COSMOS_5X6_WITH_TRACKBALLS_RIGHT

    config ZMK_SPLIT
        default y

endif
```

## boards/shields/cosmos_5x6_with_trackballs/Kconfig.shield
```kconfig
config SHIELD_COSMOS_5X6_WITH_TRACKBALLS_LEFT
    def_bool $(shields_list_contains,cosmos_5x6_with_trackballs_left)

config SHIELD_COSMOS_5X6_WITH_TRACKBALLS_RIGHT
    def_bool $(shields_list_contains,cosmos_5x6_with_trackballs_right)
```

## boards/shields/crisis_split_v1/Kconfig.defconfig
```kconfig
if SHIELD_CRISIS_SPLIT_V1_LEFT

    config ZMK_KEYBOARD_NAME
        default "CRISIS_SPLIT_V1"

    config ZMK_SPLIT_BLE_ROLE_CENTRAL
        default y

endif

if SHIELD_CRISIS_SPLIT_V1_RIGHT

    config ZMK_KEYBOARD_NAME
        default "CRISIS_SPLIT_V1_R"

endif

if SHIELD_CRISIS_SPLIT_V1_LEFT || SHIELD_CRISIS_SPLIT_V1_RIGHT

    config ZMK_SPLIT
        default y

endif
```

## build/Kconfig/Kconfig.modules
```kconfig
menu "zmk-adaptive-key (/home/ps/dev_github/zmk-config-2/modules/zmk/adaptive-key)"
osource "/home/ps/dev_github/zmk-config-2/modules/zmk/adaptive-key/Kconfig"
config ZEPHYR_ZMK_ADAPTIVE_KEY_MODULE
	bool
	default y
endmenu
menu "zmk-auto-layer (/home/ps/dev_github/zmk-config-2/modules/zmk/auto-layer)"
osource "/home/ps/dev_github/zmk-config-2/modules/zmk/auto-layer/Kconfig"
config ZEPHYR_ZMK_AUTO_LAYER_MODULE
	bool
	default y
endmenu
menu "zmk-leader-key (/home/ps/dev_github/zmk-config-2/modules/zmk/leader-key)"
osource "/home/ps/dev_github/zmk-config-2/modules/zmk/leader-key/Kconfig"
config ZEPHYR_ZMK_LEADER_KEY_MODULE
	bool
	default y
endmenu
menu "tri-state (/home/ps/dev_github/zmk-config-2/modules/zmk/tri-state)"
osource "/home/ps/dev_github/zmk-config-2/modules/zmk/tri-state/Kconfig"
config ZEPHYR_TRI_STATE_MODULE
	bool
	default y
endmenu
menu "nanopb (/home/ps/dev_github/zmk-config-2/modules/lib/nanopb)"
osource "$(ZEPHYR_NANOPB_KCONFIG)"
config ZEPHYR_NANOPB_MODULE
	bool
	default y
endmenu
menu "cmsis (/home/ps/dev_github/zmk-config-2/modules/hal/cmsis)"
osource "$(ZEPHYR_CMSIS_KCONFIG)"
config ZEPHYR_CMSIS_MODULE
	bool
	default y
endmenu
menu "hal_nordic (/home/ps/dev_github/zmk-config-2/modules/hal/nordic)"
osource "$(ZEPHYR_HAL_NORDIC_KCONFIG)"
config ZEPHYR_HAL_NORDIC_MODULE
	bool
	default y
endmenu
menu "hal_rpi_pico (/home/ps/dev_github/zmk-config-2/modules/hal/rpi_pico)"
osource "$(ZEPHYR_HAL_RPI_PICO_KCONFIG)"
config ZEPHYR_HAL_RPI_PICO_MODULE
	bool
	default y
endmenu
menu "lvgl (/home/ps/dev_github/zmk-config-2/modules/lib/gui/lvgl)"
osource "/home/ps/dev_github/zmk-config-2/modules/lib/gui/lvgl/Kconfig"
config ZEPHYR_LVGL_MODULE
	bool
	default y
endmenu
menu "module (/home/ps/dev_github/zmk-config-2/zmk/app/module)"
osource "/home/ps/dev_github/zmk-config-2/zmk/app/module/Kconfig"
config ZEPHYR_MODULE_MODULE
	bool
	default y
endmenu
```

## build/Kconfig/Kconfig.shield
```kconfig
osource "/home/ps/dev_github/zmk-config-2/zmk/app/boards/shields/*/Kconfig.shield"
osource "/home/ps/dev_github/zmk-config-2/boards/shields/*/Kconfig.shield"
```

## build/Kconfig/Kconfig.shield.defconfig
```kconfig
osource "/home/ps/dev_github/zmk-config-2/zmk/app/boards/shields/*/Kconfig.defconfig"
osource "/home/ps/dev_github/zmk-config-2/boards/shields/*/Kconfig.defconfig"
```
